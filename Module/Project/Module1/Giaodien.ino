//1=Up;0=Down;20=Pick;21=Return
void Giaodien(){
  if(digitalRead(1)==0){dong--;}
  if(digitalRead(0)==0){dong++;}
 
  if(digitalRead(20)==0){lcd.clear();dem+=10;}
  if(digitalRead(21)==0){lcd.clear();dem-=10;menu=save;dong=save1;}
  if(dem<0 || dem>20){lcd.clear();dem=0;dong=0;}
}
/******************************************************************************************************************************************************************************************/
void daunhay(){
  lcd.setCursor(0, dong);
  lcd.print(">");
  delay(100);
  lcd.setCursor(0, dong);
  lcd.print(" ");
  delay(100);
}
/******************************************************************************************************************************************************************************************/
void menu1(){
  lcd.setCursor(6, 0);
  lcd.print("Smart Pick");
  lcd.setCursor(6, 1);
  lcd.print("SNT");
  lcd.setCursor(6, 2);
  lcd.print("Carriage");
  lcd.setCursor(6, 3);
  lcd.print("Presenter");
  delay(100);
}
/******************************************************************************************************************************************************************************************/
void SMART_PICK(){
  lcd.setCursor(6, 0);
  lcd.print("Pick Mod");
  lcd.setCursor(6, 1);
  lcd.print("Dual ID");
  lcd.setCursor(6, 2);
  lcd.print("Quad CIC");
  delay(100);
}
/******************************************************************************************************************************************************************************************/
void SNT(){
  lcd.setCursor(6, 0);
  lcd.print("A");
  lcd.setCursor(6, 1);
  lcd.print("B");
  }
/******************************************************************************************************************************************************************************************/
void CARRI(){
  }
/******************************************************************************************************************************************************************************************/
void PRE(){
  lcd.setCursor(6, 0);
  lcd.print("Signal Reject");
  lcd.setCursor(6, 1);
  lcd.print("Border Reject");
  lcd.setCursor(6, 2);
  lcd.print("Coil && Latch");
  }
  
